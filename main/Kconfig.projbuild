## main/Kconfig.projbuild
```kconfig
# put here your custom config value
menu "Light Clock Configuration"

config LC_MDNS_HOSTNAME
    string "mDNS Hostname"
    default "lightclock"
    help
    Hostname for use by the mDNS responder (will have .local appended)

config LC_MDNS_INSTANCE
    string "mDNS Instance Name"
    default "Light Clock"
    help
    Human-readable mDNS Instance Name

config LC_WIFI_SSID
    string "WiFi SSID"
    default "myssid"
    help
	SSID (network name) for the example to connect to.

config LC_WIFI_PASSWORD
    string "WiFi Password"
    default "mypassword"
    help
	WiFi password (WPA or WPA2) for the example to use.

config LC_LED_STRIP_1_DATA_PIN
    int "LED Strip 1 Data Pin"
    default 12
    help
	GPIO pin number connected to LED strip 1's Data pin

config LC_LED_STRIP_2_DATA_PIN
    int "LED Strip 2 Data Pin"
    default 13
    help
	GPIO pin number connected to LED strip 2's Data pin

config LC_HTTP_SETTINGS_BUFFER_SIZE
    int "Maximum length of settings JSON contents"
    default 2048
    help
    Specifies the length of the buffers used to both stringify/send and receive settings JSON

config LC_HTTP_OTA_RX_BUFFER_SIZE
    int "OTA update HTTP buffer size (speed vs. RAM tradeoff)"
    default 2048
    help
    Specifies the length of the buffer used to receive and then copy data to flash during OTA updates. While the underlying APIs take arbitrary sizes, this should be an integer multiple of the flash page size. (The ESP32-WROOM-32 uses GD25Q32 SPI flash with a page size of 256 bytes.)

endmenu
```

## sdkconfig.defaults
```kconfig
# CONFIG_ESPTOOLPY_FLASHSIZE_1MB is not set
# CONFIG_ESPTOOLPY_FLASHSIZE_2MB is not set
CONFIG_ESPTOOLPY_FLASHSIZE_4MB=y
# CONFIG_ESPTOOLPY_FLASHSIZE_8MB is not set
# CONFIG_ESPTOOLPY_FLASHSIZE_16MB is not set
CONFIG_ESPTOOLPY_FLASHSIZE="4MB"
CONFIG_ESPTOOLPY_FLASHSIZE_DETECT=y

CONFIG_PARTITION_TABLE_TWO_OTA=y

CONFIG_BOOTLOADER_APP_ROLLBACK_ENABLE=y

CONFIG_ESP32_ENABLE_COREDUMP_TO_FLASH=y
# CONFIG_ESP32_ENABLE_COREDUMP_TO_UART is not set
# CONFIG_ESP32_ENABLE_COREDUMP_TO_NONE is not set
# CONFIG_ESP32_COREDUMP_DATA_FORMAT_BIN is not set
CONFIG_ESP32_COREDUMP_DATA_FORMAT_ELF=y
CONFIG_ESP32_COREDUMP_CHECKSUM_CRC32=y
# CONFIG_ESP32_COREDUMP_CHECKSUM_SHA256 is not set
CONFIG_ESP32_ENABLE_COREDUMP=y
CONFIG_ESP32_CORE_DUMP_MAX_TASKS_NUM=16
CONFIG_ESP32_CORE_DUMP_STACK_SIZE=0
```
